## app/boards/arm/wonderboard/Kconfig.board
```kconfig
# nice!nano board configuration

# Copyright (c) 2020 Pete Johanson
# SPDX-License-Identifier: MIT

config BOARD_WONDERBOARD
    bool "wonderboard"
    depends on SOC_NRF52840_QIAA
```

## app/boards/arm/wonderboard/Kconfig.defconfig
```kconfig
# Copyright (c) 2021 The ZMK Contributors
# SPDX-License-Identifier: MIT

if BOARD_WONDERBOARD

config BOARD
    default "wonderboard"

if USB_DEVICE_STACK

config USB_NRFX
    default y

endif # USB_DEVICE_STACK

config BT_CTLR
    default BT

endif 
```

## app/boards/shields/niche/Kconfig.defconfig
```kconfig
# Copyright (c) 2020 Ryan Cross
# SPDX-License-Identifier: MIT

if SHIELD_NICHE_LEFT
 
config ZMK_KEYBOARD_NAME
    default "Niche65"

config ZMK_SPLIT_ROLE_CENTRAL
    default y

endif

if SHIELD_NICHE_LEFT || SHIELD_NICHE_RIGHT

config ZMK_SPLIT
    default y

config ZMK_STUDIO
    default y

endif
```

## app/boards/shields/niche/Kconfig.shield
```kconfig
# Copyright (c) 2020 Ryan Cross
# SPDX-License-Identifier: MIT

config SHIELD_NICHE_LEFT
    def_bool $(shields_list_contains,niche_left)

config SHIELD_NICHE_RIGHT
    def_bool $(shields_list_contains,niche_right)
```

## app/boards/shields/nyrex65x2/Kconfig.defconfig
```kconfig
# Copyright (c) 2020 Ryan Cross
# SPDX-License-Identifier: MIT

if SHIELD_NYREX65X2_LEFT
 
config ZMK_KEYBOARD_NAME
    default "Nyrex 65X2"

config ZMK_SPLIT_ROLE_CENTRAL
    default y

config ZMK_SPLIT_BLE_CENTRAL_BATTERY_LEVEL_PROXY
    default y

config ZMK_SPLIT_BLE_CENTRAL_BATTERY_LEVEL_FETCHING
    default y

endif

if SHIELD_NYREX65X2_LEFT || SHIELD_NYREX65X2_RIGHT

config ZMK_SPLIT
    default y

config ZMK_STUDIO
    default y

endif
```

## app/boards/shields/nyrex65x2/Kconfig.shield
```kconfig
# Copyright (c) 2020 Ryan Cross
# SPDX-License-Identifier: MIT

config SHIELD_NYREX65X2_LEFT
    def_bool $(shields_list_contains,nyrex65x2_left)

config SHIELD_NYREX65X2_RIGHT
    def_bool $(shields_list_contains,nyrex65x2_right)
```

## app/boards/shields/nyrex65x2dvt/Kconfig.shield
```kconfig
# Copyright (c) 2020 Ryan Cross
# SPDX-License-Identifier: MIT

config SHIELD_NYREX65X2DVT_LEFT
    def_bool $(shields_list_contains,nyrex65x2dvt_left)

config SHIELD_NYREX65X2DVT_RIGHT
    def_bool $(shields_list_contains,nyrex65x2dvt_right)
```

## app/boards/shields/nyrex65x2dvtflipped/Kconfig.defconfig
```kconfig
# Copyright (c) 2020 Ryan Cross
# SPDX-License-Identifier: MIT

if SHIELD_NYREX65X2DVTFLIPPED_LEFT
 
config ZMK_KEYBOARD_NAME
    default "Nyrex 65X2 DVTF"

config ZMK_SPLIT_ROLE_CENTRAL
    default y

endif

if SHIELD_NYREX65X2DVTFLIPPED_LEFT || SHIELD_NYREX65X2DVTFLIPPED_RIGHT

config ZMK_SPLIT
    default y

config ZMK_STUDIO
    default y

endif
```

## app/boards/shields/nyrex65x2dvtflipped/Kconfig.shield
```kconfig
# Copyright (c) 2020 Ryan Cross
# SPDX-License-Identifier: MIT

config SHIELD_NYREX65X2DVTFLIPPED_LEFT
    def_bool $(shields_list_contains,nyrex65x2dvtflipped_left)

config SHIELD_NYREX65X2DVTFLIPPED_RIGHT
    def_bool $(shields_list_contains,nyrex65x2dvtflipped_right)
```
