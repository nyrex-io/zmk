/*
 * Copyright (c) 2020 Pete Johanson
 *
 * SPDX-License-Identifier: MIT
 */

#include "nyrex65x2dvt.dtsi"

&kscan0 {
    
    col-gpios
        = <&wonderboard 6 GPIO_ACTIVE_HIGH>
        , <&wonderboard 5 GPIO_ACTIVE_HIGH>
        , <&wonderboard 4 GPIO_ACTIVE_HIGH>
        , <&wonderboard 3 GPIO_ACTIVE_HIGH>
        , <&wonderboard 2 GPIO_ACTIVE_HIGH> 
        , <&wonderboard 1 GPIO_ACTIVE_HIGH>
        , <&wonderboard 0 GPIO_ACTIVE_HIGH>
        ;

    row-gpios
        = <&wonderboard 29 (GPIO_ACTIVE_HIGH | GPIO_PULL_DOWN)>
        , <&wonderboard 30 (GPIO_ACTIVE_HIGH | GPIO_PULL_DOWN)>
        , <&wonderboard 31 (GPIO_ACTIVE_HIGH | GPIO_PULL_DOWN)>
        , <&wonderboard 32 (GPIO_ACTIVE_HIGH | GPIO_PULL_DOWN)>
        , <&wonderboard 33 (GPIO_ACTIVE_HIGH | GPIO_PULL_DOWN)>
        ;
};
