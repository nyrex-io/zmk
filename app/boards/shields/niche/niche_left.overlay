/*
 * Copyright (c) 2020 Ryan Cross
 *
 * SPDX-License-Identifier: MIT
 */

#include "niche.dtsi"

&kscan0 {
    col-gpios
        = <&wonderboard 5 GPIO_ACTIVE_HIGH>
        , <&wonderboard 6 GPIO_ACTIVE_HIGH>
        , <&wonderboard 7 GPIO_ACTIVE_HIGH>
        , <&wonderboard 8 GPIO_ACTIVE_HIGH>
        , <&wonderboard 9 GPIO_ACTIVE_HIGH> /*5x1*/
        , <&wonderboard 10 GPIO_ACTIVE_HIGH>
        , <&wonderboard 11 GPIO_ACTIVE_HIGH>
        ;

    row-gpios
        = <&wonderboard 4 (GPIO_ACTIVE_HIGH | GPIO_PULL_DOWN)>
        , <&wonderboard 3 (GPIO_ACTIVE_HIGH | GPIO_PULL_DOWN)>
        , <&wonderboard 2 (GPIO_ACTIVE_HIGH | GPIO_PULL_DOWN)>
        , <&wonderboard 1 (GPIO_ACTIVE_HIGH | GPIO_PULL_DOWN)>
        , <&wonderboard 0 (GPIO_ACTIVE_HIGH | GPIO_PULL_DOWN)>
        ;
};
