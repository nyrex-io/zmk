/*
 * Copyright (c) 2020 Ryan Cross
 *
 * SPDX-License-Identifier: MIT
 */

#include "niche.dtsi"

&default_transform {
    col-offset = <7>;
};

&kscan0 {
    col-gpios
        = <&wonderboard 16 GPIO_ACTIVE_HIGH>
        , <&wonderboard 17 GPIO_ACTIVE_HIGH>
        , <&wonderboard 18 GPIO_ACTIVE_HIGH>
        , <&wonderboard 19 GPIO_ACTIVE_HIGH>
        , <&wonderboard 20 GPIO_ACTIVE_HIGH>
        , <&wonderboard 21 GPIO_ACTIVE_HIGH>
        , <&wonderboard 22 GPIO_ACTIVE_HIGH>
        , <&wonderboard 24 GPIO_ACTIVE_HIGH>
        , <&wonderboard 23 GPIO_ACTIVE_HIGH>
        ;

    row-gpios
        = <&wonderboard 25 (GPIO_ACTIVE_HIGH | GPIO_PULL_DOWN)>
        , <&wonderboard 26 (GPIO_ACTIVE_HIGH | GPIO_PULL_DOWN)>
        , <&wonderboard 27 (GPIO_ACTIVE_HIGH | GPIO_PULL_DOWN)>
        , <&wonderboard 28 (GPIO_ACTIVE_HIGH | GPIO_PULL_DOWN)>
        , <&wonderboard 29 (GPIO_ACTIVE_HIGH | GPIO_PULL_DOWN)>
        ;
};

